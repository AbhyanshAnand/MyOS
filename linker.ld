/*
 * linker.ld - Linker script for a 64-bit Multiboot2 kernel
 *
 * This script defines how different sections of your compiled kernel
 * (from boot.asm, kernel.c, kprint.c, kinput.c) are arranged in the
 * final kernel.elf executable.
 *
 * Key principles:
 * - ENTRY(_start): Specifies the initial entry point for the kernel,
 * which must match the global _start label in boot.asm.
 * - . = 0x100000: Sets the base address for the kernel in memory to 1MB.
 * GRUB typically loads Multiboot2 kernels at this address.
 * - ALIGN(4K): Ensures that sections start on a 4KB page boundary,
 * which is essential for paging and memory management in modern CPUs.
 * - /DISCARD/: Discards sections that are generated by the compiler/linker
 * but are not needed in a freestanding kernel environment (e.g., debugging info).
 */

ENTRY(_start)

SECTIONS {
    /*
     * Set the starting address of the kernel in virtual memory.
     * GRUB loads the kernel at 1MB (0x100000).
     */
    . = 0x100000;

    /*
     * The .boot section contains the Multiboot2 header and initial
     * 32-bit assembly code (from boot.asm). It must be the first section.
     * Ensure it's 4KB aligned.
     */
    .boot ALIGN(4K) :
    {
        *(.boot)
    }

    /*
     * The .text section contains the executable code (from C and 64-bit assembly).
     * Align it to a 4KB page boundary.
     */
    .text ALIGN(4K) :
    {
        *(.text)
    }

    /*
     * The .rodata section contains read-only data (e.g., string literals).
     * Align it to a 4KB page boundary.
     */
    .rodata ALIGN(4K) :
    {
        *(.rodata)
    }

    /*
     * The .data section contains initialized global and static variables.
     * Align it to a 4KB page boundary.
     */
    .data ALIGN(4K) :
    {
        *(.data)
    }

    /*
     * The .bss section contains uninitialized global and static variables.
     * These are zero-initialized by the kernel or bootloader.
     * Align it to a 4KB page boundary.
     */
    .bss ALIGN(4K) :
    {
        *(.bss)
    }

    /*
     * Discard any sections that are not needed for a bare-metal kernel.
     * This helps keep the kernel image small and avoids potential issues
     * with sections that rely on a full operating system environment.
     * - .eh_frame: Exception handling information.
     * - .note.GNU-stack: Marker for executable stack (not strictly needed here).
     */
    /DISCARD/ :
    {
        *(.eh_frame)
        *(.note.GNU-stack)
    }
}
